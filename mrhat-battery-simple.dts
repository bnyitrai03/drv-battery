/*
* Copyright (C) 2024 Effective Range Kft.
*
* This program is free software; you can redistribute it and/or modify
* it under the terms of the GNU General Public License version 2 as
* published by the Free Software Foundation.
*/
/dts-v1/;
/plugin/;

/* Reference values taken from  EB535151VU  /drivers/power/supply/samsung-sdi-battery.c */
/ {
    compatible = "brcm,bcm2835";
    fragment@0{
        target-path = "/";
        __overlay__ {
            status = "okay";
            BAT1: battery {
                compatible = "simple-battery";
                constant-charge-current-max-microamp = <3000000>;
                constant-charge-voltage-max-microvolt = <4200000>;
                precharge-current-microamp = <123000>;
                charge-term-current-microamp = <123000>;
                charge-full-design-microamp-hours = <9800000>;
                device-chemistry = "lithium-ion";
                factory-internal-resistance-micro-ohms = <100000>;
                factory-internal-resistance-charging-micro-ohms = <400000>;  
              
                /* this is an array of temperature in descending order, and 
                * as the number of  ocv-capacity-table-X tables corresponds to
                * ocv-capacity-celsius[X] temperature
                */
                ocv-capacity-celsius = <250>;
                ocv-capacity-table-0 = 
                    <4200000 100>,
                    <4100000 95>,
                    <4000000 90>,
                    <3900000 85>;
                    <3820000 80>;
                    <3750000 70>;
                    <3720000 60>;
                    <3700000 50>;
                    <3680000 40>;
                    <3650000 30>;
                    <3620000 20>;
                    <3550000 15>;
                    <3400000 10>;
                    <3000000 0>;

                /* generic LiIon resistance change over temperature */        
                /* Temperature [0.1 C] Percentage of resistance     */        
                resistance-temp-table = 
                     <500 45>,
                     <400 60>,
                     <350 100>,
                     <150 100>,
                     <100 150>,
                     < 0  200>;
            };
        };
    };

    fragment@1{
        target-path = "/";
        __overlay__ {
            status = "okay";
            aliases {
                BAT1 = <&BAT1>;
            };
        };
    };
    
    fragment@2{
        target-path = "/";
        __overlay__ {
            status = "okay";
            __symbols__ {
                BAT1 = "/battery";
            };
        };
    };

    __overrides__ {
        max_charge_uA = <&BAT1>, "constant-charge-current-max-microamp:0";
        max_charge_uV = <&BAT1>, "constant-charge-voltage-max-microvolt:0";
        pre_charge_uA = <&BAT1>, "precharge-current-microamp:0";
        charge_term_uA = <&BAT1>, "charge-term-current-microamp:0";
        bat_capacity_uAh = <&BAT1>, "charge-full-design-microamp-hours:0";
    };
};
